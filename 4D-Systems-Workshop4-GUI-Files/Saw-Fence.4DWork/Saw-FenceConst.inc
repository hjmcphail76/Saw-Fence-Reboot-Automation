// File generated 6/11/2025 3:04:44 PM
// Warning! This is a generated file, any manual changes will be
// lost during the next generation.

#DATA
    byte iKeyboard0keystrokes 0x37, 0x38, 0x39, 0x34, 0x35, 0x36, 0x31, 0x32, 0x33, 0x0D, 0x30, 0x08, 0x6E
#END


#constant  IFONT_OFFSET     0
// object indexes into FlashBank Functions
#CONST
    Fgfx_Button5                1
    Fgfx_Label2                 2  // Genie, double byte string from RAM
    Fgfx_MediaButton            3
    Fgfx_MediaGauge             4
    Fgfx_MediaPanel             5
    Fgfx_MediaRotary            6
    Fgfx_MediaSlider            7
    Fgfx_MediaThermometer       8
    Fgfx_Slider3                9
    Fgfx_Slider4                10
    Fgfx_Slider6                11
    Fgfx_Slider7                12
    Fgfx_Slider8                13
    Fgfx_Switch2                14
#END
// object indexes into WIDGET pointer
#CONST
    iILabelB0
    iILabelB1
#END

// object indexes into ImageControl
#CONST
    iImage0         // offset 0x0
    iStatictext0    // offset 0x3B600
    iWinbutton0     // offset 0x3C400
    iWinbutton1     // offset 0x48400
    iWinbutton2     // offset 0x59800
    iWinbutton3     // offset 0x66A00
    iWinbutton4     // offset 0x73400
    iKeyboard0      // offset 0x80600
    iKeyboard0_0    // offset 0xA5E00
    iKeyboard0_1    // offset 0xAA800
    iKeyboard0_2    // offset 0xAF200
    iKeyboard0_3    // offset 0xB3C00
    iKeyboard0_4    // offset 0xB8600
    iKeyboard0_5    // offset 0xBD000
    iKeyboard0_6    // offset 0xC1A00
    iKeyboard0_7    // offset 0xC6400
    iKeyboard0_8    // offset 0xCAE00
    iKeyboard0_9    // offset 0xCF800
    iKeyboard0_10   // offset 0xD8C00
    iKeyboard0_11   // offset 0xDD600
    iKeyboard0_12   // offset 0xE2000
    iStatictext1    // offset 0xE6A00
    iStatictext2    // offset 0xE7400
    iWinbutton5     // offset 0xE8800
    i4Dbutton0      // offset 0xF0000
    iWinbutton6     // offset 0xF4200
    iStatictext5    // offset 0xFD200
    iStatictext3    // offset 0x100400
    iStatictext4    // offset 0x123800
    iStatictext6    // offset 0x131E00
#END



#IFNOT EXISTS NOGLOBALS
var hndl ;
var oKeyboard0[12] := [-1, 0, 0, 0, 0, 255, 255, 255, 255, 255, 13, 0] ;
#ENDIF
